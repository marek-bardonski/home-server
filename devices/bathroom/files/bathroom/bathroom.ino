/*
 * bathroom — Phase 2: on-device mmWave night light + MQTT mirror.
 *
 * Hardware: M5Stack AtomS3 Lite (ESP32-S3) on an ATOM Hub Proto board.
 *   - Grove RGB LED Matrix w/ Driver (Seeed 104020208) in the Grove port (I2C).
 *   - S3KM1110 24 GHz mmWave radar (Waveshare 26536) wired by label:
 *       radar 3V3 -> Atom 3V3   (NEVER 5V — module is 3.0–3.6 V only)
 *       radar GND -> Atom GND
 *       radar OUT -> Atom G5    (active-high on presence, 3.3 V logic)
 *       radar TX/RX -> not connected (digital-only path)
 *
 * The presence->light loop runs ENTIRELY on the AtomS3 and is completely
 * independent of Wi-Fi/MQTT — the night light keeps working with the network
 * down. MQTT is only a mirror, scoped here to exactly two things:
 *
 *   A) every radar OUT edge is published so the raspberry-hex hub can
 *      SQLite-log when presence was detected (usage tracking). This happens
 *      regardless of the enable switch below.
 *   B) a retained "enable" command (driven by an Apple Home switch on the hub)
 *      can disable the light: when disabled the matrix stays dark even on
 *      motion — but presence is still detected, logged, and published.
 *
 * BRIGHTNESS IS HARD-CAPPED at ~10% (CAP) — standing rule: safe on a
 * current-limited laptop USB port and the night light is meant to be dim.
 *
 * arduino_secrets.h is generated by update.sh from the repo-root .env at
 * compile time and deleted right after — never committed. Deploy with
 * `./update.sh bathroom` (USB; device.conf sets ARDUINO_USB_MATCH so the
 * ESP32-S3 is detected on the serial port).
 */

#include <Wire.h>
#include <WiFi.h>
#include <ArduinoOTA.h>          // esp32 core's OTA (port 3232 / espota.py)
#include <ArduinoMqttClient.h>
#include "arduino_secrets.h"
// "Seeed_RGB_Led_Matrix" lib (v1.0.0): lowercase header, no begin(); init is
// Wire.begin() + scanGroveTwoRGBLedMatrixI2CAddress() (auto 0x65/0x60).
#include "grove_two_rgb_led_matrix.h"

#define GROVE_SDA 2          // AtomS3 Lite Grove port
#define GROVE_SCL 1
#define MATRIX_ADDR 0x65

#define RADAR_PIN 5          // G5 = GPIO5, radar OUT (active-high presence)

// ~10% per-channel cap (0x1A = 26/255). Do not raise without leaving laptop
// power. Dark amber = full-cap red + ~40% green, no blue.
#define CAP 0x1A
static inline uint32_t amber(uint8_t b) {
  return ((uint32_t)b << 16) | ((uint32_t)(b * 2 / 5) << 8);
}

// Stay lit this long after the LAST time presence was seen.
static const uint32_t HOLD_MS = 5UL * 60UL * 1000UL;   // 5 minutes
// Fade-in is instant (snap to full on presence); only the fade-out is gradual.
// The fade-out step interval is the full duration / CAP brightness steps.
static const uint16_t FADE_OUT_MS      = 30000;        // 30 s gradual fall
static const uint16_t FADE_OUT_STEP_MS = FADE_OUT_MS / CAP;   // ~1.15 s/step

// --- MQTT (home/<device>/<metric>), same conventions as sypialnia ---
static const char* MQTT_TOPIC_STATUS     = "home/bathroom/status";
static const char* MQTT_TOPIC_PRESENCE   = "home/bathroom/presence";
// Inbound, retained: HomeKit switch on raspberry-hex publishes {"on":bool};
// the broker replays the last value on every reconnect so a node reboot keeps
// the user's choice.
static const char* MQTT_TOPIC_ENABLE_SET = "home/bathroom/enable/set";
static const char* MQTT_TOPIC_IP         = "home/bathroom/ip";

static const char* OTA_HOSTNAME = "bathroom";   // also the espota target name

static const uint32_t WIFI_RETRY_MS = 5000;
static const uint32_t MQTT_RETRY_MS = 5000;
// Periodic liveness: re-publish retained status so the hub's last-seen ts
// stays fresh and the dashboard can flag a device that went quiet.
static const uint32_t HEARTBEAT_MS  = 30000;

WiFiClient wifiClient;
MqttClient mqttClient(wifiClient);
GroveTwoRGBLedMatrixClass matrix;

// ISR captures the precise leading edge so latency is the true hardware->MCU
// time, not a polling artefact.
volatile uint32_t g_edgeMicros = 0;
volatile bool     g_edge       = false;
static void IRAM_ATTR onRadarRise() { g_edgeMicros = micros(); g_edge = true; }

enum LightState { S_OFF, S_RAMP_UP, S_ON_HOLD, S_RAMP_DOWN };
static LightState state = S_OFF;
static uint8_t  brightness = 0;          // current, 0..CAP
static int16_t  lastWritten = -1;        // last value pushed to the matrix
static uint32_t lastPresenceMs = 0;
static uint32_t lastStepMs = 0;
static bool     prevPresent = false;     // for radar edge logging/publishing
static uint32_t presentSinceMs = 0;
static bool     gEnabled = true;         // B: night light allowed? (default on)
static uint32_t lastWifiTry = 0;
static uint32_t lastMqttTry = 0;
static bool     otaBegun = false;        // (re)armed whenever Wi-Fi is up
static uint32_t lastHeartbeatMs = 0;

static void writeMatrix(uint8_t b) {
  if ((int16_t)b == lastWritten) return;     // don't spam the I2C bus
  matrix.displayColorBlock(b ? amber(b) : 0x000000, 0, true);
  lastWritten = b;
}

static void i2cScan() {
  Serial.println("I2C scan:");
  uint8_t found = 0;
  for (uint8_t a = 1; a < 127; a++) {
    Wire.beginTransmission(a);
    if (Wire.endTransmission() == 0) {
      Serial.printf("  device @ 0x%02X%s\n", a,
                    a == MATRIX_ADDR ? "  <- matrix" : "");
      found++;
    }
  }
  if (!found) Serial.println("  (none — check Grove cable / SDA-SCL / 5V)");
}

// B: parse the retained enable command. Minimal substring parse, mirroring
// sypialnia's hand-built JSON (no ArduinoJson dependency). {"on":true} enables.
void onMqttMessage(int /*size*/) {
  char buf[64];
  int n = 0;
  while (mqttClient.available() && n < (int)sizeof(buf) - 1)
    buf[n++] = (char)mqttClient.read();
  buf[n] = '\0';
  bool en = strstr(buf, "\"on\":true") != nullptr;
  if (en != gEnabled) {
    gEnabled = en;
    Serial.printf("ENABLE cmd: night light %s\n", en ? "ENABLED" : "DISABLED");
  }
}

bool connectToWiFi() {
  if (WiFi.status() == WL_CONNECTED) return true;
  WiFi.mode(WIFI_STA);
  WiFi.begin(SECRET_SSID, SECRET_PASS);   // non-blocking on ESP32
  return WiFi.status() == WL_CONNECTED;
}

// ESP32 OTA (port 3232). Re-armed by serviceNetwork after every Wi-Fi
// (re)connect. update.sh drives it via the esp32 core's espota.py.
void beginOta() {
  ArduinoOTA.setHostname(OTA_HOSTNAME);
  ArduinoOTA.setPassword(SECRET_OTA_PASS);
  ArduinoOTA.begin();
  Serial.printf("OTA armed as '%s' @ %s:3232\n",
                OTA_HOSTNAME, WiFi.localIP().toString().c_str());
}

bool connectToMqtt() {
  if (mqttClient.connected()) return true;
  if (WiFi.status() != WL_CONNECTED) return false;
  mqttClient.setId("bathroom");
  mqttClient.beginWill(MQTT_TOPIC_STATUS, true, 1);
  mqttClient.print("offline");
  mqttClient.endWill();
  if (!mqttClient.connect(MQTT_HOST, MQTT_PORT)) {
    Serial.printf("MQTT connect failed (err %d)\n", mqttClient.connectError());
    return false;
  }
  mqttClient.beginMessage(MQTT_TOPIC_STATUS, true);
  mqttClient.print("online");
  mqttClient.endMessage();
  // Retained IP so the hub/dashboard always show where to reach this node
  // (also the address to point OTA at).
  String ip = WiFi.localIP().toString();
  mqttClient.beginMessage(MQTT_TOPIC_IP, true);
  mqttClient.print(ip);
  mqttClient.endMessage();
  // Retained command replays immediately on (re)subscribe.
  mqttClient.subscribe(MQTT_TOPIC_ENABLE_SET, 1);
  lastHeartbeatMs = millis();
  Serial.printf("MQTT connected — IP %s\n", ip.c_str());
  return true;
}

// A: mirror every radar edge so the hub can log presence timing. Best-effort:
// if MQTT is down the night light is unaffected, we just skip the publish.
void publishPresence(bool present) {
  if (!mqttClient.connected()) return;
  mqttClient.beginMessage(MQTT_TOPIC_PRESENCE, false);
  mqttClient.print(present ? "{\"present\":true}" : "{\"present\":false}");
  mqttClient.endMessage();
}

// Network upkeep — throttled and non-blocking so it never stalls the reflex.
void serviceNetwork(uint32_t now) {
  if (WiFi.status() != WL_CONNECTED) {
    otaBegun = false;   // re-arm OTA after the next reconnect
    if (now - lastWifiTry >= WIFI_RETRY_MS) { lastWifiTry = now; connectToWiFi(); }
    return;
  }
  if (!otaBegun) { beginOta(); otaBegun = true; }
  ArduinoOTA.handle();   // quick when idle; busy only during an actual upload

  if (!mqttClient.connected()) {
    if (now - lastMqttTry >= MQTT_RETRY_MS) { lastMqttTry = now; connectToMqtt(); }
  } else {
    mqttClient.poll();
    // Heartbeat: refresh retained status so the hub's last-seen ts advances
    // and the dashboard can tell this node is alive.
    if (now - lastHeartbeatMs >= HEARTBEAT_MS) {
      lastHeartbeatMs = now;
      mqttClient.beginMessage(MQTT_TOPIC_STATUS, true);
      mqttClient.print("online");
      mqttClient.endMessage();
    }
  }
}

void setup() {
  Serial.begin(115200);
  delay(400);
  Serial.printf("\nbathroom Phase 2 — mmWave night light (capped @ ~%d%%, "
                "hold %lus) + MQTT mirror\n",
                (CAP * 100 + 127) / 255, HOLD_MS / 1000);

  Wire.begin(GROVE_SDA, GROVE_SCL);
  i2cScan();
  matrix.scanGroveTwoRGBLedMatrixI2CAddress();
  Serial.printf("matrix bound @ 0x%02X, VID 0x%04X (expect 0x2886)\n",
                matrix.currentDeviceAddress, matrix.getDeviceVID());
  writeMatrix(0);

  // Pulldown so the input is a defined low if the radar hasn't driven OUT yet
  // (harmless against the radar's push-pull output once it is up).
  pinMode(RADAR_PIN, INPUT_PULLDOWN);
  attachInterrupt(digitalPinToInterrupt(RADAR_PIN), onRadarRise, RISING);

  // Register once; the callback persists across MQTT reconnects.
  mqttClient.onMessage(onMqttMessage);
  connectToWiFi();
  connectToMqtt();
  Serial.println("armed — waiting for presence on G5");
}

void loop() {
  const uint32_t now = millis();
  serviceNetwork(now);                            // best-effort, never blocks reflex

  const bool present = digitalRead(RADAR_PIN);    // raw radar (ungated)
  if (present) lastPresenceMs = now;

  // A + diagnostics: log & publish every radar OUT transition. Independent of
  // the enable switch, so usage is tracked even while the light is disabled.
  if (present != prevPresent) {
    if (present) {
      presentSinceMs = now;
      bool haveRxn = false; uint32_t rxn = 0;
      if (g_edge) {
        noInterrupts();
        const uint32_t em = g_edgeMicros;
        g_edge = false;
        interrupts();
        rxn = micros() - em; haveRxn = true;
      }
      if (haveRxn)
        Serial.printf("RADAR ^ presence @ %lums (MCU reaction %luus)\n",
                      now, (unsigned long)rxn);
      else
        Serial.printf("RADAR ^ presence @ %lums\n", now);
    } else {
      Serial.printf("RADAR v clear    @ %lums (was present %lums; "
                    "%lus hold starts now)\n",
                    now, now - presentSinceMs, HOLD_MS / 1000);
    }
    publishPresence(present);
    prevPresent = present;
  }

  // B: when disabled, force the light off and never let it ramp up.
  if (!gEnabled && (state == S_RAMP_UP || state == S_ON_HOLD)) {
    state = S_RAMP_DOWN;
    lastStepMs = now;
    Serial.printf("disabled @ %lums — fading out\n", now);
  }

  const bool inHold = gEnabled && (present || (now - lastPresenceMs < HOLD_MS));

  switch (state) {
    case S_OFF:
      if (present && gEnabled) { state = S_RAMP_UP; lastStepMs = now; }
      break;

    case S_RAMP_UP:
      // Instant on: snap straight to full, no gradual rise.
      writeMatrix(brightness = CAP);
      state = S_ON_HOLD;
      Serial.printf("night light on (~%d%%, instant) @ %lums\n",
                    (CAP * 100 + 127) / 255, now);
      break;

    case S_ON_HOLD:
      if (!inHold) {
        state = S_RAMP_DOWN;
        lastStepMs = now;
        Serial.printf("hold expired (%lus, no presence) @ %lums — fade out\n",
                      HOLD_MS / 1000, now);
      }
      break;

    case S_RAMP_DOWN:
      if (present && gEnabled) {            // came back mid-fade
        state = S_RAMP_UP;
        lastStepMs = now;
        Serial.printf("presence again @ %lums — back up\n", now);
      } else if (now - lastStepMs >= FADE_OUT_STEP_MS) {
        lastStepMs = now;
        writeMatrix(--brightness);
        if (brightness == 0) {
          state = S_OFF;
          Serial.printf("OFF @ %lums\n", now);
        }
      }
      break;
  }

  delay(2);   // ~500 Hz poll; the ISR still catches the exact edge
}
