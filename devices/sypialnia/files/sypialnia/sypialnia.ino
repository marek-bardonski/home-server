/*
 * sypialnia — minimal production firmware for the bedroom CO2 node.
 *
 * Trimmed from the reference `waku` sketch. Only three responsibilities:
 *   1. OTA over Wi-Fi — the deploy transport driven by ../../../update.sh.
 *   2. Read the MH-Z19B CO2 sensor and publish it over MQTT.
 *   3. Drive the outward-facing RGB LED as a HomeKit lamp: it follows the
 *      retained command on home/sypialnia/led/set (on/off + brightness),
 *      published by the raspberry-hex HomeKit bridge.
 *
 * Everything else from waku (alarm, dawn light, buzzer, OLED, RTC, button,
 * LED matrix, HTTP client, FreeRTOS) is intentionally omitted. The full
 * hardware wiring table is preserved in this device's README.md for future use.
 *
 * arduino_secrets.h is generated by update.sh from the repo-root .env at
 * compile time and deleted immediately after — it is never committed.
 */
#include <WiFiS3.h>
#include <ArduinoOTA.h>
#include <ArduinoMqttClient.h>

#include "arduino_secrets.h"
#include "co2_sensor.h"

// --- Pins (from the waku wiring; see README.md) ---
static const int CO2_PWM_PIN = 2;   // PIN 2  -> MH-Z19B PWM output
static const int LED_R_PIN   = 10;  // PIN 10 -> LED #2 (red channel)
static const int LED_G_PIN   = 11;  // PIN 11 -> LED #3 (green channel)
static const int LED_B_PIN   = 9;   // PIN 9  -> LED #1 (blue channel)

// --- Timing ---
static const unsigned long CO2_PUBLISH_INTERVAL_MS = 15000;
static const unsigned long WIFI_RETRY_INTERVAL_MS  = 5000;

// --- MQTT topics (home/<device>/<metric>) ---
static const char* MQTT_TOPIC_CO2     = "home/sypialnia/co2";
static const char* MQTT_TOPIC_STATUS  = "home/sypialnia/status";
static const char* MQTT_TOPIC_IP      = "home/sypialnia/ip";
// Inbound LED command from the HomeKit bridge; retained, so the broker
// replays the last state to us on every (re)connect.
static const char* MQTT_TOPIC_LED_SET = "home/sypialnia/led/set";

WiFiClient wifiClient;
MqttClient mqttClient(wifiClient);
CO2Sensor  co2Sensor(CO2_PWM_PIN);

unsigned long lastCo2Publish = 0;

// LED state, driven by HomeKit via the retained MQTT command topic above.
bool gLedOn = false;
int  gLedBrightness = 100;  // HomeKit brightness, 0..100

void applyLed() {
  // White lamp: drive R/G/B equally, scaled 0..255 from the HomeKit
  // brightness (0..100). Off forces 0 regardless of brightness.
  int duty = gLedOn ? (int)((long)gLedBrightness * 255 / 100) : 0;
  analogWrite(LED_R_PIN, duty);
  analogWrite(LED_G_PIN, duty);
  analogWrite(LED_B_PIN, duty);
}

void onMqttMessage(int /*messageSize*/) {
  // Only the LED command is subscribed. Read the payload, then parse it
  // minimally — no ArduinoJson dependency, mirroring the hand-built JSON
  // used for publishing. Hub sends compact {"on":true,"brightness":80}.
  char buf[80];
  int n = 0;
  while (mqttClient.available() && n < (int)sizeof(buf) - 1) {
    buf[n++] = (char)mqttClient.read();
  }
  buf[n] = '\0';

  gLedOn = strstr(buf, "\"on\":true") != nullptr;
  const char* bp = strstr(buf, "\"brightness\":");
  if (bp) {
    int b = atoi(bp + 13);  // strlen("\"brightness\":") == 13
    gLedBrightness = b < 0 ? 0 : (b > 100 ? 100 : b);
  }
  applyLed();
  Serial.print("LED cmd: on=");
  Serial.print(gLedOn ? "1" : "0");
  Serial.print(" brightness=");
  Serial.println(gLedBrightness);
}

bool connectToWiFi() {
  if (WiFi.status() == WL_CONNECTED) return true;
  for (int attempt = 0; attempt < 5; attempt++) {
    Serial.print("WiFi connect attempt ");
    Serial.println(attempt + 1);
    if (WiFi.begin(SECRET_SSID, SECRET_PASS) == WL_CONNECTED) {
      Serial.print("WiFi connected, IP: ");
      Serial.println(WiFi.localIP());
      return true;
    }
    delay(WIFI_RETRY_INTERVAL_MS);
  }
  Serial.println("WiFi connection failed");
  return false;
}

void beginOta() {
  // OTA must be available whenever Wi-Fi is up; serviced by ArduinoOTA.poll()
  // in loop() every iteration (the reference waku never polled it, so its
  // OTA never actually worked).
  //
  // The 2nd arg is the mDNS name the board advertises for OTA discovery; it
  // MUST match ARDUINO_OTA_ADDRESS in device.conf (sypialnia.local) or
  // arduino-cli reports "No device found". The waku default of "Arduino"
  // advertised as Arduino.local and never matched.
  ArduinoOTA.begin(WiFi.localIP(), "sypialnia", SECRET_OTA_PASS, InternalStorage);
}

bool connectToMqtt() {
  if (mqttClient.connected()) return true;
  if (WiFi.status() != WL_CONNECTED) return false;

  mqttClient.setId("sypialnia");
  // Last will: the broker marks us offline if the connection drops.
  mqttClient.beginWill(MQTT_TOPIC_STATUS, true, 1);
  mqttClient.print("offline");
  mqttClient.endWill();

  Serial.print("Connecting to MQTT ");
  Serial.print(MQTT_HOST);
  Serial.print(":");
  Serial.println(MQTT_PORT);
  if (!mqttClient.connect(MQTT_HOST, MQTT_PORT)) {
    Serial.print("MQTT connect failed, error ");
    Serial.println(mqttClient.connectError());
    return false;
  }
  Serial.println("MQTT connected");

  mqttClient.beginMessage(MQTT_TOPIC_STATUS, true);
  mqttClient.print("online");
  mqttClient.endMessage();

  // Retained IP so the hub/dashboard show every node's address (not just
  // this one) in one place. Hand-formatted for portability across cores.
  IPAddress ip = WiFi.localIP();
  char ipbuf[16];
  snprintf(ipbuf, sizeof(ipbuf), "%d.%d.%d.%d", ip[0], ip[1], ip[2], ip[3]);
  mqttClient.beginMessage(MQTT_TOPIC_IP, true);
  mqttClient.print(ipbuf);
  mqttClient.endMessage();

  // (Re)subscribe on every (re)connect. The command is published retained,
  // so the broker immediately replays the last LED state to onMqttMessage().
  mqttClient.subscribe(MQTT_TOPIC_LED_SET, 1);
  return true;
}

void publishCo2() {
  int ppm = co2Sensor.readPWM();
  bool valid = ppm > 0;
  String payload = String("{\"ppm\":") + ppm +
                   ",\"valid\":" + (valid ? "true" : "false") + "}";
  mqttClient.beginMessage(MQTT_TOPIC_CO2, true);
  mqttClient.print(payload);
  mqttClient.endMessage();
  Serial.print("Published ");
  Serial.print(MQTT_TOPIC_CO2);
  Serial.print(" -> ");
  Serial.println(payload);
}

void setup() {
  Serial.begin(9600);
  unsigned long t0 = millis();
  while (!Serial && millis() - t0 < 3000) { ; }  // don't block forever headless
  Serial.println("\nsypialnia waking up...");

  pinMode(LED_R_PIN, OUTPUT);
  pinMode(LED_G_PIN, OUTPUT);
  pinMode(LED_B_PIN, OUTPUT);

  co2Sensor.begin();
  applyLed();  // defined initial state (off) until the first command arrives

  // Register once; the callback pointer persists across MQTT reconnects.
  mqttClient.onMessage(onMqttMessage);

  connectToWiFi();
  beginOta();
  connectToMqtt();
}

void loop() {
  // 1. OTA — poll every iteration so a deploy is never missed.
  ArduinoOTA.poll();

  // 2. Keep the network up; re-arm OTA after a reconnect.
  if (WiFi.status() != WL_CONNECTED) {
    if (connectToWiFi()) beginOta();
  }
  if (!mqttClient.connected()) {
    connectToMqtt();
  } else {
    mqttClient.poll();
  }

  // 3. Publish CO2 on a fixed cadence.
  unsigned long now = millis();
  if (now - lastCo2Publish >= CO2_PUBLISH_INTERVAL_MS) {
    lastCo2Publish = now;
    if (mqttClient.connected()) publishCo2();
  }

  // The LED is event-driven: onMqttMessage() applies each HomeKit command as
  // it arrives (and the retained command replays on reconnect), so loop()
  // has nothing periodic to do for it.
}
